## Beluga/config/kconfig/Kconfig.uwb
```kconfig
menu "Beluga UWB Settings"

config ENABLE_BELUGA_UWB
    bool "Enables DecaDriver library for UWB"
    default y

config UWB_BOOT_BANNER
    bool "UWB Boot Banner"
    default n
    select PRINTK
    select EARLY_CONSOLE
    depends on ENABLE_BELUGA_UWB

config UWB_INIT_RX_TIMEOUT
    int "Initiator receive timeout (ms)"
    default 2700
    depends on ENABLE_BELUGA_UWB

config UWB_RESP_RX_DELAY
    int "Responder receive delay (ms)"
    default 0
    depends on ENABLE_BELUGA_UWB

config UWB_RESP_RX_TIMEOUT
    int "Responder receive timeout (ms)"
    default 0
    depends on ENABLE_BELUGA_UWB

menuconfig UWB_FILTER_RANGES
    bool "Filter UWB neighbors by range"
    default n
    help
        Exclude neighbors that are within a certain distance and beyond a certain distance

if UWB_FILTER_RANGES
config UWB_RANGE_FILTER_LOWER_BOUND
    int "Lower bound of the range filtering"
    default -5
    help
        This is the lower bound of the range filtering. If a lower bound is not desired,
        then set it to a negative value.

config UWB_RANGE_FILTER_UPPER_BOUND
    int "Upper bound of the range filtering"
    default -5
    help
        This is the upper bound of the range filtering. If an upper bound is not desired,
        then set it to a negative value.
endif # UWB_FILTER_RANGES

config POLL_RX_TO_RESP_TX_DLY
    int "Poll RX to Response Delay in microseconds"
    default 1500
    help
        Critical value for porting to different processors. For slower platforms where
        the SPI is at a slower speed or the processor is operating at a lower frequency
        (Comparing to STM32F, SPI of 18MHz and Processor internal 72MHz)this value needs
        to be increased. Knowing the exact time when the responder is going to send its
        response is vital for time of flight calculation. The specification of the time
        of respnse must allow the processor enough time to do its calculations and put
        the packet in the Tx buffer. So more time required for a slower system (processor).

config DWT_API_ERROR_CHECK
    bool "Have DecaDriver check for errors"
    default n

config UWB_ENABLE_PA
    bool "Allow the UWB external power amplifier to be toggled on"
    default y

config MAX_POLLING_RATE
    int "Maximum Polling Rate (ms)"
    default 500

config POLLING_REFRESH
    int "Refresh Period while Polling"
    default 100
    help
        This determines the maximum amount of ms the ranging task can sleep for; However,
        it is important to note that this is different than the polling rate. The polling
        rate is what determines how often the system should poll the distances for other
        nodes while this parameter indicates the maximum amount of time the polling thread
        can sleep for, thus allowing for the ranging thread to update the count for polling
        neighbors and suspending/releasing the responder task independently from the polling
        rate.

config POLLING_REFRESH_PERIOD
    int
    default 100 if POLLING_REFRESH < 100
    default 500 if POLLING_REFRESH > 500
    default POLLING_REFRESH

config PWRAMP_ALLOW_BAD_CHANNELS
    bool "Allow invalid UWB channels to use the amplifier"
    default n

config REPORT_UWB_DROPS
    bool "Report dropped UWB ranging estimates"
    default n

config UWB_DIAGNOSTICS
    bool "Record UWB diagnostics with the ranging estimates"
    default n
    help
        This allows the DW1000 to record its diagnostics information after each successful
        ranging attempt. WARNING: The more nodes that are on the network, the more heap
        memory is required to report the data. It is recommended that at most 4 nodes are
        used.

config UWB_FRAME_FILTER
    bool "Filter frames on the DW1000 [Experimental]"
    default n
    select EXPERIMENTAL

config RESPONDER_TIMEOUT
    int "UWB Responder task timeout (ms)"
    default 1000

config INITIATOR_TIMEOUT
    int "UWB Initiator task timeout (ms)"
    default 1000

config RESP_SUSPEND_SCHED
    bool "Suspend scheduler when responding [EXPERIMENTAL]"
    select EXPERIMENTAL
    default n

endmenu # Beluga UWB Settings
```

## Beluga/config/kconfig/Kconfig.watchdog
```kconfig
menu "Watchdog"

config SW_WDT_CHANNELS
    int "Number of watchdog channels"
    default 4

config SW_WDT_HW_FALLBACK
    bool "Hardware watchdog timer fallback"
    select WATCHDOG
    default y

config SW_WDT_HW_FALLBACK_DELAY
    int "Milliseconds before the HW WDT triggers"
    depends on SW_WDT_HW_FALLBACK
    default 1000
    help
        Milliseconds before the HW WDT triggers. This also serves
        as the minimum period for software watchdog periods.


config SW_WDT_MIN_DELAY
    int "Minimum timeout period (ms) for software watchdog"
    depends on !SW_WDT_HW_FALLBACK
    default 1000

endmenu # Watchdog
```

## boards/arm/Beluga/Beluga_defconfig
```kconfig
CONFIG_SOC_SERIES_NRF52X=y
CONFIG_SOC_NRF52840_QIAA=y
CONFIG_BOARD_BELUGA=y

CONFIG_ARM_MPU=y
CONFIG_HW_STACK_PROTECTION=y

CONFIG_PINCTRL=y
```

## boards/arm/Beluga/Kconfig.board
```kconfig
config BOARD_BELUGA
	bool "Custom Board auto generated by nRF Connect for VS Code"
	depends on SOC_NRF52840_QIAA
```

## boards/arm/Beluga/Kconfig.defconfig
```kconfig
if BOARD_BELUGA

config BOARD
	default "Beluga"

config BT_CTLR
	default BT

endif # BOARD_BELUGA
```

## boards/arm/beluga2/Kconfig.board
```kconfig
# Copyright (c) 2024 Nordic Semiconductor ASA
# SPDX-License-Identifier: Apache-2.0

config BOARD_BELUGA2
	bool "Beluga2"
	depends on SOC_NRF52832_QFAA
```

## boards/arm/beluga2/Kconfig.defconfig
```kconfig
# Copyright (c) 2024 Nordic Semiconductor ASA
# SPDX-License-Identifier: Apache-2.0

if BOARD_BELUGA2

config BOARD
	default "beluga2"

config BT_CTLR
   default BT


endif
```

## boards/arm/beluga2/beluga2_defconfig
```kconfig
# Copyright (c) 2024 Nordic Semiconductor ASA
# SPDX-License-Identifier: Apache-2.0

CONFIG_SOC_SERIES_NRF52X=y
CONFIG_SOC_NRF52832_QFAA=y
CONFIG_BOARD_BELUGA2=y

# Enable MPU
CONFIG_ARM_MPU=y

# Enable hardware stack protection
CONFIG_HW_STACK_PROTECTION=y
```

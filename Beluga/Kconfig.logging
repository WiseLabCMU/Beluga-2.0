## Beluga/Kconfig.logging
```kconfig
menu "Logger configurations"

comment "All of these configurations depend on LOG"

menu "Serial"
menu "Serial Comms"
module = COMMS
module-str = Comms module
source "subsys/logging/Kconfig.template.log_config"
endmenu

menu "Comms Backend"
module = COMMS_SERIAL
module-str = Comms Backend module
source "subsys/logging/Kconfig.template.log_config"
endmenu
endmenu

menu "App LEDs"
module = APP_LEDS
module-str = App LEDs
source "subsys/logging/Kconfig.template.log_config"
endmenu

menu "AT Commands"
module = AT_COMMANDS
module-str = AT commands
source "subsys/logging/Kconfig.template.log_config"
endmenu

menu "Beluga Message"
module = BELUGA_MESSAGE
module-str = Beluga message
source "subsys/logging/Kconfig.template.log_config"
endmenu

menu "BLE Application"
module = BLE_APP
module-str = BLE application
source "subsys/logging/Kconfig.template.log_config"
endmenu

menu "Debug"
module = BELUGA_DEBUG
module-str = Beluga debugging
source "subsys/logging/Kconfig.template.log_config"
endmenu

menu "Initiator"
module = INITIATOR
module-str = Initiator
source "subsys/logging/Kconfig.template.log_config"
endmenu

menu "List Monitor"
module = LIST_MONITOR
module-str = List monitor
source "subsys/logging/Kconfig.template.log_config"
endmenu

menu "Neighbor Listing"
module = NEIGHBOR_LISTING
module-str = Neighbor listing module
source "subsys/logging/Kconfig.template.log_config"
endmenu

menu "Main Application"
module = BELUGA_MAIN
module-str = Beluga main
source "subsys/logging/Kconfig.template.log_config"
endmenu

menu "Power Manager"
module = POWER_MANAGER
module-str = Power manager
source "subsys/logging/Kconfig.template.log_config"
endmenu

menu "Range Extension"
module = RANGE_EXTENSION
module-str = Range extension
source "subsys/logging/Kconfig.template.log_config"
endmenu

menu "Ranging"
module = RANGING_MODULE
module-str = ranging module
source "subsys/logging/Kconfig.template.log_config"
endmenu

menu "Responder"
module = RESPONDER
module-str = Responder
source "subsys/logging/Kconfig.template.log_config"
endmenu

menu "Serial LEDs"
module = SERIAL_LED
module-str = Serial LEDs
source "subsys/logging/Kconfig.template.log_config"
endmenu

menu "Settings"
module = SETTINGS_MODULE
module-str = settings
source "subsys/logging/Kconfig.template.log_config"
endmenu

menu "SPI module"
module = SPI_MODULE
module-str = SPI module
source "subsys/logging/Kconfig.template.log_config"
endmenu

menu "Voltage Regulator"
module = VOLTAGE_REG_MODULE
module-str = Voltage regulator module
source "subsys/logging/Kconfig.template.log_config"
endmenu

menu "Watchdog"
module = WATCHDOG_MODULE
module-str = watchdog module
source "subsys/logging/Kconfig.template.log_config"
endmenu

endmenu
```

## Beluga/Kconfig.neighbors
```kconfig
menu "Neighbor List Settings"

config BELUGA_NETWORK_SIZE
    int "The number of nodes in the network"
    default 12

choice
    prompt "Eviction Scheme"
    default BELUGA_EVICT_RSSI

config BELUGA_EVICT_RR
    bool "Round Robin"

config BELUGA_EVICT_RSSI
    bool "RSSI"

config BELUGA_EVICT_RANGE
    bool "Range"

config BELUGA_EVICT_BLE_TS
    bool "BLE Timestamp"

config BELUGA_EVICT_RANGE_TS
    bool "Range Timestamp"

config BELUGA_EVICT_RUNTIME_SELECT
    bool "Select at runtime"

endchoice

endmenu
```

## Beluga/Kconfig.uwb
```kconfig
menu "Beluga UWB Settings"

config ENABLE_BELUGA_UWB
    bool "Enables DecaDriver library for UWB"
    default y

config TX_ANT_DLY
    int "Transmitter Antenna Delay [DEPRECATED]"
    default 16436
    depends on ENABLE_BELUGA_UWB
    help
        The sum of the values is the TX to RX antenna delay.
        This should be experimentally determined by a calibration process.
        This configuration is deprecated as it should be something that
        is calibrated and saved in flash for each device.

config RX_ANT_DLY
    int "Receiver Antenna Delay [DEPRECATED]"
    default 16436
    depends on ENABLE_BELUGA_UWB
    help
        The sum of the values is the TX to RX antenna delay.
        This should be experimentally determined by a calibration process.
        This configuration is deprecated as it should be something that
        is calibrated and saved in flash for each device.

config UWB_BOOT_BANNER
    bool "UWB Boot Banner"
    default n
    select PRINTK
    select EARLY_CONSOLE
    depends on ENABLE_BELUGA_UWB

config UWB_INIT_RX_TIMEOUT
    int "Initiator receive timeout (ms)"
    default 2700
    depends on ENABLE_BELUGA_UWB

config UWB_RESP_RX_DELAY
    int "Responder receive delay (ms)"
    default 0
    depends on ENABLE_BELUGA_UWB

config UWB_RESP_RX_TIMEOUT
    int "Responder receive timeout (ms)"
    default 0
    depends on ENABLE_BELUGA_UWB

menuconfig UWB_FILTER_RANGES
    bool "Filter UWB neighbors by range"
    default n
    help
        Exclude neighbors that are within a certain distance and beyond a certain distance

if UWB_FILTER_RANGES
config UWB_RANGE_FILTER_LOWER_BOUND
    int "Lower bound of the range filtering"
    default -5
    help
        This is the lower bound of the range filtering. If a lower bound is not desired,
        then set it to a negative value.

config UWB_RANGE_FILTER_UPPER_BOUND
    int "Upper bound of the range filtering"
    default -5
    help
        This is the upper bound of the range filtering. If an upper bound is not desired,
        then set it to a negative value.
endif

config POLL_RX_TO_RESP_TX_DLY
    int "Poll RX to Response Delay in microseconds"
    default 1500
    help
        Critical value for porting to different processors. For slower platforms where
        the SPI is at a slower speed or the processor is operating at a lower frequency
        (Comparing to STM32F, SPI of 18MHz and Processor internal 72MHz)this value needs
        to be increased. Knowing the exact time when the responder is going to send its
        response is vital for time of flight calculation. The specification of the time
        of respnse must allow the processor enough time to do its calculations and put
        the packet in the Tx buffer. So more time required for a slower system (processor).

config DWT_API_ERROR_CHECK
    bool "Have DecaDriver check for errors"
    default n

config UWB_ENABLE_PA
    bool "Allow the UWB external to be toggled on"
    default y

config MAX_POLLING_RATE
    int "Maximum Polling Rate (ms)"
    default 500

config POLLING_REFRESH
    int "Refresh Period while Polling"
    default 100
    help
        This determines the maximum amount of ms the ranging task can sleep for; However,
        it is important to note that this is different than the polling rate. The polling
        rate is what determines how often the system should poll the distances for other
        nodes while this parameter indicates the maximum amount of time the polling thread
        can sleep for, thus allowing for the ranging thread to update the count for polling
        neighbors and suspending/releasing the responder task independently from the polling
        rate.

config POLLING_REFRESH_PERIOD
    int
    default 100 if POLLING_REFRESH < 100
    default 500 if POLLING_REFRESH > 500
    default POLLING_REFRESH

endmenu
```

## Beluga/boards/wiselab/beluga/Kconfig.defconfig
```kconfig
if BOARD_BELUGA

config BT_CTLR
	default BT

config SERIAL_LEDS
    bool "Serial LEDs"
    default y

endif # BOARD_BELUGA
```

## Beluga/build/Kconfig/Kconfig.sysbuild.modules
```kconfig
menu "nrf (/home/tom/nordic/v2.6.1/nrf)"
osource "/home/tom/nordic/v2.6.1/nrf/sysbuild/Kconfig.sysbuild"
config ZEPHYR_NRF_MODULE
	bool
	default y
endmenu
```

## Beluga/config/kconfig/Kconfig.beluga_debug
```kconfig
menu "Beluga Debugging"

comment "You can turn on the Kernel Logging Subsystem from \"Subsystems and OS Services->Logging->Logging\""

rsource "./Kconfig.logging"

config DEBUG_BELUGA_CLOCK
    bool "Debug oscillating crystals"
    default n

config BELUGA_RESET_REASON
    bool "Print the reset reason"
    select HWINFO
    default n

config BELUGA_EVAL_BLE_STRENGTH
    bool "Evaluate the signal strength of BLE regardless if UWB is on or not"
    default n

config WDT_TEST_COMMAND
    bool "Enable WDT test command"
    default n

endmenu # Beluga Debugging
```

## Beluga/config/kconfig/Kconfig.beluga_threads
```kconfig
menu "Thread Configurations"

config ENABLE_COMMANDS
    bool "Enable commands for Beluga"
    default y

config BELUGA_COMMANDS_PRIO
    int "Priority for commands thread"
    depends on ENABLE_COMMANDS
    default 7

config COMMANDS_STACK_SIZE
    int "Stack size (bytes) for commands thread"
    depends on ENABLE_COMMANDS
    default 2048

config ENABLE_LIST
    bool "Enable the list thread for Beluga"
    default y

config BELUGA_LIST_PRIO
    int "Priority for list thread"
    depends on ENABLE_LIST
    default 7

config LIST_STACK_SIZE
    int "Stack size (bytes) for list thread"
    depends on ENABLE_LIST
    default 3640

config ENABLE_RANGING
    bool "Enable the ranging thread for Beluga"
    default y

config BELUGA_RANGING_PRIO
    int "Priority for ranging thread"
    depends on ENABLE_RANGING
    default 7

config RANGING_STACK_SIZE
    int "Stack size (bytes) for ranging thread"
    depends on ENABLE_RANGING
    default 1240

config ENABLE_MONITOR
    bool "Enable the monitor thread in Beluga"
    default y

config BELUGA_MONITOR_PRIO
    int "Priority for monitor thread"
    depends on ENABLE_MONITOR
    default 7

config MONITOR_STACK_SIZE
    int "Stack size (bytes) for monitor task"
    depends on ENABLE_MONITOR
    default 2940

config ENABLE_RESPONDER
    bool "Enable the responder thread in Beluga"
    default y

config BELUGA_RESPONDER_PRIO
    int "Priority for responder thread"
    depends on ENABLE_RESPONDER
    default 8

config RESPONDER_STACK_SIZE
    int "Stack size (bytes) for responder task"
    depends on ENABLE_RESPONDER
    default 1536

endmenu  # Thread Configurations
```

## Beluga/config/kconfig/Kconfig.logging
```kconfig
menu "Logger configurations"

comment "All of these configurations depend on LOG"

menu "Beluga Service Client"
module = BELUGA_SERVICE_CLIENT
module-str = Beluga Service Client
source "subsys/logging/Kconfig.template.log_config"
endmenu # Beluga Service Client

menu "Beluga Service"
module = BELUGA_SERVICE
module-str = Beluga Service
source "subsys/logging/Kconfig.template.log_config"
endmenu # Beluga Service

menu "Serial"
menu "Serial Comms"
module = COMMS
module-str = Comms module
source "subsys/logging/Kconfig.template.log_config"
endmenu # Serial Comms

menu "Comms Backend"
module = COMMS_SERIAL
module-str = Comms Backend module
source "subsys/logging/Kconfig.template.log_config"
endmenu # Comms Backend
endmenu # Serial

menu "App LEDs"
module = APP_LEDS
module-str = App LEDs
source "subsys/logging/Kconfig.template.log_config"
endmenu # App LEDs

menu "AT Commands"
module = AT_COMMANDS
module-str = AT commands
source "subsys/logging/Kconfig.template.log_config"
endmenu # AT Commands

menu "Beluga Message"
module = BELUGA_MESSAGE
module-str = Beluga message
source "subsys/logging/Kconfig.template.log_config"
endmenu # Beluga Message

menu "BLE Application"
module = BLE_APP
module-str = BLE application
source "subsys/logging/Kconfig.template.log_config"
endmenu # BLE Application

menu "Debug"
module = BELUGA_DEBUG
module-str = Beluga debugging
source "subsys/logging/Kconfig.template.log_config"
endmenu # Debug

menu "Initiator"
module = INITIATOR
module-str = Initiator
source "subsys/logging/Kconfig.template.log_config"
endmenu # Initiator

menu "List Monitor"
module = LIST_MONITOR
module-str = List monitor
source "subsys/logging/Kconfig.template.log_config"
endmenu # List Monitor

menu "Neighbor Listing"
module = NEIGHBOR_LISTING
module-str = Neighbor listing module
source "subsys/logging/Kconfig.template.log_config"
endmenu # Neighbor Listing

menu "Main Application"
module = BELUGA_MAIN
module-str = Beluga main
source "subsys/logging/Kconfig.template.log_config"
endmenu # Main Application

menu "Power Manager"
module = POWER_MANAGER
module-str = Power manager
source "subsys/logging/Kconfig.template.log_config"
endmenu # Power Manager

menu "Range Extension"
module = RANGE_EXTENSION
module-str = Range extension
source "subsys/logging/Kconfig.template.log_config"
endmenu # Range Extension

menu "Ranging"
module = RANGING_MODULE
module-str = ranging module
source "subsys/logging/Kconfig.template.log_config"
endmenu # Ranging

menu "Responder"
module = RESPONDER
module-str = Responder
source "subsys/logging/Kconfig.template.log_config"
endmenu # Responder

menu "Serial LEDs"
module = SERIAL_LED
module-str = Serial LEDs
source "subsys/logging/Kconfig.template.log_config"
endmenu # Serial LEDs

menu "Settings"
module = SETTINGS_MODULE
module-str = settings
source "subsys/logging/Kconfig.template.log_config"
endmenu # Settings

menu "SPI module"
module = SPI_MODULE
module-str = SPI module
source "subsys/logging/Kconfig.template.log_config"
endmenu # SPI module

menu "Voltage Regulator"
module = VOLTAGE_REG_MODULE
module-str = Voltage regulator module
source "subsys/logging/Kconfig.template.log_config"
endmenu # Voltage Regulator

menu "Watchdog"
module = WATCHDOG_MODULE
module-str = watchdog module
source "subsys/logging/Kconfig.template.log_config"
endmenu # Watchdog

endmenu # Logger configurations
```

## Beluga/config/kconfig/Kconfig.neighbors
```kconfig
menu "Neighbor List Settings"

config BELUGA_NETWORK_SIZE
    int "The number of nodes in the network"
    default 12

choice
    prompt "Eviction Scheme"
    default BELUGA_EVICT_RSSI

config BELUGA_EVICT_RR
    bool "Round Robin"

config BELUGA_EVICT_RSSI
    bool "RSSI"

config BELUGA_EVICT_RANGE
    bool "Range"

config BELUGA_EVICT_BLE_TS
    bool "BLE Timestamp"

config BELUGA_EVICT_RANGE_TS
    bool "Range Timestamp"

config BELUGA_EVICT_RUNTIME_SELECT
    bool "Select at runtime"

endchoice

config RANGE_TO_ACTIVE_ONLY
    bool "Only range to active neighbors"
    default n
    help
        When enabled, this will filter out the neighbors
        that do not have UWB active. If disabled, then
        the modem will continue to range to neighbors
        that do not have UWB active (Good for UWB
        power evaluation).

endmenu
```

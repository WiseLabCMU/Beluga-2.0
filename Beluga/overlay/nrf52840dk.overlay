/ {
	nrf_radio_fem: sky66112-11 {
		compatible = "skyworks,sky66112-11", "generic-fem-two-ctrl-pins";
		ctx-gpios = <&gpio1 1 0>;
		crx-gpios = <&gpio1 2 0>;
		tx-gain-db = <22>;
	};

	sky_fem_gpios: amp_control {
		compatible = "amp-control";
		ant-sel-gpios = <&gpio1 11 0>;
		csd-gpios = <&gpio0 28 GPIO_ACTIVE_LOW>;
		cps-gpios = <&gpio0 29 GPIO_ACTIVE_HIGH>;
		chl-gpios = <&gpio1 10 0>;
	};
};

&radio {
	fem = <&nrf_radio_fem>;
};

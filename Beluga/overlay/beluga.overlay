#include <zephyr/dt-bindings/gpio/gpio.h>

/ {
	 vr_adjust: vr_adjust {
		 compatible = "vr-adjust";
		 status = "disabled";
		 gpios = <&gpio1 0 0>;
	 };

//	zephyr,user {
//		wake-source-gpios = <&gpio0 15 0>;
//	};
 };

&uart0 {
	status = "disabled";
};
